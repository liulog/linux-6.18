## drivers/gpu/drm/img-rogue/Kconfig
```kconfig
config POWERVR_ROGUE
	tristate "PowerVR GPU"
	default n
	depends on DRM
	help
	  Driver for PowerVR graphics processor hardware.

	  Say Y here if your SoC contains a PowerVR GPU. For more
	  information, see <http://www.imgtec.com/powervr/>.

config POWERVR_DVFS
	tristate "PowerVR GPU DVFS"
	default n
	depends on POWERVR_ROGUE && PM_DEVFREQ && PM_OPP
	select DEVFREQ_GOV_SIMPLE_ONDEMAND
	help
	  Enable Dynamic Voltage and Frequency Scaling (DVFS) support
	  for PowerVR GPU. This allows the GPU frequency and voltage to
	  be adjusted dynamically based on workload to optimize power
	  consumption and performance.

	  Requires kernel support for devfreq (CONFIG_PM_DEVFREQ) and
	  Operating Performance Points (CONFIG_PM_OPP).

	  Say Y here if you want to enable DVFS.

config POWERVR_THERMAL
	tristate "PowerVR GPU Thermal"
	default n
	depends on POWERVR_ROGUE && POWERVR_DVFS && DEVFREQ_THERMAL && K3_THERMAL
	help
	  Enable thermal management support for PowerVR GPU.
	  This allows the GPU to adjust frequency and voltage
	  based on thermal conditions.

	  Requires kernel support for devfreq thermal
	  (CONFIG_DEVFREQ_THERMAL) and K3 thermal
	  (CONFIG_K3_THERMAL).

	  Say Y here if you want to enable PowerVR thermal management.

config POWERVR_DISABLE_APM
    bool "Disable PowerVR Active Power Management (APM)"
    default n
    depends on POWERVR_ROGUE
    help
      When enabled, this option disables the Active Power Management (APM)
      feature of the PowerVR GPU driver. PowerVR's APM is forcibly turned off,
      which may impact power consumption characteristics.

      Note: It is recommended to leave this disabled (default) unless you have
      specific requirements for disabling APM.
```
